## configs/orangepi_3_defconfig
```kconfig
CONFIG_ARM=y
CONFIG_ARCH_SUNXI=y
CONFIG_NR_DRAM_BANKS=1
CONFIG_SPL=y
CONFIG_USE_PREBOOT=y
CONFIG_MACH_SUN50I_H6=y
CONFIG_SUNXI_DRAM_H6_LPDDR3=y
CONFIG_MMC0_CD_PIN="PF6"
# CONFIG_PSCI_RESET is not set
# CONFIG_SYS_MALLOC_CLEAR_ON_INIT is not set
# CONFIG_CMD_FLASH is not set
# CONFIG_SPL_DOS_PARTITION is not set
# CONFIG_SPL_EFI_PARTITION is not set
CONFIG_DEFAULT_DEVICE_TREE="sun50i-h6-orangepi-3"
# CONFIG_SUN8I_EMAC is not set
# CONFIG_NET is not set
# CONFIG_DM_ETH is not set
# CONFIG_CMD_NET is not set
# CONFIG_CMD_DHCP is not set
# CONFIG_CMD_PXE is not set
# CONFIG_CMD_NFS is not set
# CONFIG_CMD_MII is not set
# CONFIG_CMD_PING is not set
# CONFIG_DISTRO_DEFAULTS is not set
CONFIG_CMD_FAT=y
CONFIG_CMD_FS_GENERIC=y
CONFIG_CMD_PART=y
CONFIG_HUSH_PARSER=y
CONFIG_BOOTDELAY=1
CONFIG_ISO_PARTITION=y
CONFIG_SYS_CONSOLE_INFO_QUIET=y
CONFIG_CMD_BOOTM=y
CONFIG_LZ4=y
CONFIG_FIT=y
# CONFIG_CMD_BOOTEFI is not set
# CONFIG_EFI_PARTITION is not set
# CONFIG_EFI_LOADER is not set
# CONFIG_CMD_NVEDIT_EFI is not set
CONFIG_FIXUP_BDADDR="brcm,bcm4345c5"

CONFIG_SPL_SERIAL_SUPPORT=n
# CONFIG_SPL_SERIAL_PRESENT is not set
# CONFIG_SPL_BANNER_PRINT is not set
# CONFIG_SPL_DISPLAY_PRINT is not set
```

## configs/orangepi_one_defconfig
```kconfig
CONFIG_ARM=y
CONFIG_ARCH_SUNXI=y
CONFIG_SPL=y
CONFIG_MACH_SUN8I_H3=y
CONFIG_DRAM_CLK=672
# CONFIG_SYS_MALLOC_CLEAR_ON_INIT is not set
CONFIG_DEFAULT_DEVICE_TREE="sun8i-h3-orangepi-one"
CONFIG_SUN8I_EMAC=y
CONFIG_USB_EHCI_HCD=y
CONFIG_USB_OHCI_HCD=y
# CONFIG_SUN8I_EMAC is not set
# CONFIG_NET is not set
# CONFIG_DM_ETH is not set
# CONFIG_CMD_NET is not set
# CONFIG_CMD_DHCP is not set
# CONFIG_CMD_PXE is not set
# CONFIG_CMD_NFS is not set
# CONFIG_CMD_MII is not set
# CONFIG_CMD_PING is not set
# CONFIG_DISTRO_DEFAULTS is not set
CONFIG_CMD_BOOTZ=y
CONFIG_CMD_FAT=y
CONFIG_CMD_FS_GENERIC=y
CONFIG_CMD_PART=y
CONFIG_HUSH_PARSER=y
CONFIG_BOOTDELAY=1
CONFIG_ISO_PARTITION=y
CONFIG_CMD_BOOTM=y
CONFIG_LZ4=y
CONFIG_FIT=y
# CONFIG_CMD_BOOTEFI is not set
# CONFIG_EFI_PARTITION is not set
# CONFIG_EFI_LOADER is not set
# CONFIG_CMD_NVEDIT_EFI is not set
```

## configs/orangepi_pc2_defconfig
```kconfig
CONFIG_ARM=y
CONFIG_ARCH_SUNXI=y
CONFIG_SPL=y
CONFIG_MACH_SUN50I_H5=y
CONFIG_DRAM_CLK=672
CONFIG_DRAM_ZQ=3881977
# CONFIG_DRAM_ODT_EN is not set
CONFIG_MACPWR="PD6"
CONFIG_SPL_SPI_SUNXI=y
# CONFIG_SYS_MALLOC_CLEAR_ON_INIT is not set
CONFIG_DEFAULT_DEVICE_TREE="sun50i-h5-orangepi-pc2"
CONFIG_SUN8I_EMAC=y
CONFIG_USB_EHCI_HCD=y
CONFIG_USB_OHCI_HCD=y
CONFIG_USB_MUSB_GADGET=y
# CONFIG_SUN8I_EMAC is not set
# CONFIG_NET is not set
# CONFIG_DM_ETH is not set
# CONFIG_CMD_NET is not set
# CONFIG_CMD_DHCP is not set
# CONFIG_CMD_PXE is not set
# CONFIG_CMD_NFS is not set
# CONFIG_CMD_MII is not set
# CONFIG_CMD_PING is not set
# CONFIG_DISTRO_DEFAULTS is not set
CONFIG_CMD_FAT=y
CONFIG_CMD_FS_GENERIC=y
CONFIG_CMD_PART=y
CONFIG_HUSH_PARSER=y
CONFIG_BOOTDELAY=1
CONFIG_ISO_PARTITION=y
CONFIG_SYS_CONSOLE_INFO_QUIET=y
CONFIG_CMD_BOOTM=y
CONFIG_LZ4=y
CONFIG_FIT=y
# CONFIG_CMD_BOOTEFI is not set
# CONFIG_EFI_PARTITION is not set
# CONFIG_EFI_LOADER is not set
# CONFIG_CMD_NVEDIT_EFI is not set
```

## configs/orangepi_pc_defconfig
```kconfig
CONFIG_ARM=y
CONFIG_ARCH_SUNXI=y
CONFIG_SPL=y
CONFIG_MACH_SUN8I_H3=y
CONFIG_DRAM_CLK=624
# CONFIG_SYS_MALLOC_CLEAR_ON_INIT is not set
CONFIG_SPL_I2C_SUPPORT=y
CONFIG_DEFAULT_DEVICE_TREE="sun8i-h3-orangepi-pc"
CONFIG_SUN8I_EMAC=y
CONFIG_SY8106A_POWER=y
CONFIG_USB_EHCI_HCD=y
CONFIG_USB_OHCI_HCD=y
# CONFIG_SUN8I_EMAC is not set
# CONFIG_NET is not set
# CONFIG_DM_ETH is not set
# CONFIG_CMD_NET is not set
# CONFIG_CMD_DHCP is not set
# CONFIG_CMD_PXE is not set
# CONFIG_CMD_NFS is not set
# CONFIG_CMD_MII is not set
# CONFIG_CMD_PING is not set
# CONFIG_DISTRO_DEFAULTS is not set
CONFIG_CMD_BOOTZ=y
CONFIG_CMD_FAT=y
CONFIG_CMD_FS_GENERIC=y
CONFIG_CMD_PART=y
CONFIG_HUSH_PARSER=y
CONFIG_BOOTDELAY=1
CONFIG_ISO_PARTITION=y
CONFIG_SY8106A_VOUT1_VOLT=1320
CONFIG_SYS_CLK_FREQ=1296000000
CONFIG_SYS_CONSOLE_INFO_QUIET=y
CONFIG_CMD_BOOTM=y
CONFIG_LZ4=y
CONFIG_FIT=y
# CONFIG_CMD_BOOTEFI is not set
# CONFIG_EFI_PARTITION is not set
# CONFIG_EFI_LOADER is not set
# CONFIG_CMD_NVEDIT_EFI is not set
```

## configs/pinephone_defconfig
```kconfig
CONFIG_ARM=y
CONFIG_ARCH_SUNXI=y
CONFIG_DEFAULT_DEVICE_TREE="sun50i-a64-pinephone-1.2"
CONFIG_SPL_DRIVERS_MISC=y
CONFIG_SPL=y
CONFIG_PINEPHONE_LEDS=y
CONFIG_MACH_SUN50I=y
CONFIG_SUNXI_DRAM_LPDDR3_STOCK=y
CONFIG_DRAM_CLK=552
CONFIG_DRAM_ZQ=3881949
CONFIG_MMC_SUNXI_SLOT_EXTRA=2
CONFIG_PINEPHONE_DT_SELECTION=y
# CONFIG_SYS_MALLOC_CLEAR_ON_INIT is not set
CONFIG_OF_LIST="sun50i-a64-pinephone-1.1 sun50i-a64-pinephone-1.2"
CONFIG_LED_STATUS=y
CONFIG_LED_STATUS_GPIO=y
CONFIG_LED_STATUS0=y
CONFIG_LED_STATUS_BIT=114
CONFIG_LED_STATUS_STATE=2

CONFIG_LZ4=y
CONFIG_GZIP=y
CONFIG_CMD_UNZIP=y
CONFIG_CMD_EXT4=y
CONFIG_SUPPORT_RAW_INITRD=y
CONFIG_FS_EXT4=y
CONFIG_CMD_EXT4_WRITE=y
CONFIG_EXT4_WRITE=y
CONFIG_BOOTDELAY=0
CONFIG_OF_LIBFDT_OVERLAY=y

CONFIG_IDENT_STRING=" SkiffOS"
```

## configs/pocketbook_touch_lux_3_defconfig
```kconfig
CONFIG_ARM=y
CONFIG_ARCH_SUNXI=y
CONFIG_NR_DRAM_BANKS=1
CONFIG_SPL=y
CONFIG_MACH_SUN5I=y
CONFIG_DRAM_CLK=408
CONFIG_DRAM_EMR1=0
CONFIG_MMC0_CD_PIN="PG0"
CONFIG_CONS_INDEX=2
CONFIG_MMC_SUNXI_SLOT_EXTRA=2
CONFIG_MMC2_BUS_WIDTH=4
CONFIG_AXP_GPIO=y
CONFIG_SPL_I2C_SUPPORT=y
CONFIG_DEFAULT_DEVICE_TREE="sun5i-a13-pocketbook-touch-lux-3"
# CONFIG_SYS_MALLOC_CLEAR_ON_INIT is not set
# CONFIG_CMD_FLASH is not set
# CONFIG_SPL_DOS_PARTITION is not set
# CONFIG_SPL_EFI_PARTITION is not set
# CONFIG_SUN8I_EMAC is not set
# CONFIG_NET is not set
# CONFIG_DM_ETH is not set
# CONFIG_CMD_NET is not set
# CONFIG_CMD_DHCP is not set
# CONFIG_CMD_PXE is not set
# CONFIG_CMD_NFS is not set
# CONFIG_CMD_MII is not set
# CONFIG_CMD_PING is not set
# CONFIG_DISTRO_DEFAULTS is not set
# CONFIG_VIDEO_SUNXI is not set
# CONFIG_VIDEO_HDMI is not set
# CONFIG_VIDEO is not set
CONFIG_CMD_FAT=y
CONFIG_CMD_FS_GENERIC=y
CONFIG_CMD_PART=y
CONFIG_HUSH_PARSER=y
CONFIG_BOOTDELAY=0
CONFIG_ISO_PARTITION=y
CONFIG_SYS_CONSOLE_INFO_QUIET=y
CONFIG_CMD_BOOTZ=y
#CONFIG_USB0_VBUS_PIN="PG12"
#CONFIG_USB0_VBUS_DET="PG1"
#CONFIG_USB0_ID_DET="PG2"
```

## configs/tbs_a711_defconfig
```kconfig
CONFIG_ARM=y
CONFIG_ARCH_SUNXI=y
CONFIG_SPL=y
CONFIG_MACH_SUN8I_A83T=y
CONFIG_DRAM_TYPE=7
CONFIG_DRAM_CLK=552
CONFIG_DRAM_ZQ=15355
CONFIG_DRAM_ODT_EN=y
CONFIG_MMC_SUNXI_SLOT_EXTRA=2
CONFIG_USB0_VBUS_PIN="AXP0-VBUS-ENABLE"
CONFIG_USB0_VBUS_DET="AXP0-VBUS-DETECT"
CONFIG_USB0_ID_DET="PH11"
CONFIG_AXP_GPIO=y
# CONFIG_SYS_MALLOC_CLEAR_ON_INIT is not set
CONFIG_DEFAULT_DEVICE_TREE="sun8i-a83t-tbs-a711"
CONFIG_FASTBOOT_CMD_OEM_FORMAT=y
CONFIG_AXP_DCDC5_VOLT=1200
CONFIG_USB_EHCI_HCD=y
CONFIG_USB_OHCI_HCD=y
CONFIG_USB_MUSB_GADGET=y
CONFIG_USB_FUNCTION_MASS_STORAGE=y
# CONFIG_SUN8I_EMAC is not set
# CONFIG_NET is not set
# CONFIG_DM_ETH is not set
# CONFIG_CMD_NET is not set
# CONFIG_CMD_DHCP is not set
# CONFIG_CMD_PXE is not set
# CONFIG_CMD_NFS is not set
# CONFIG_CMD_MII is not set
# CONFIG_CMD_PING is not set
# CONFIG_CMD_LOADB is not set
# CONFIG_CMD_LOADS is not set
# CONFIG_DISTRO_DEFAULTS is not set
CONFIG_CMD_BOOTZ=y
CONFIG_CMD_FAT=y
CONFIG_CMD_FS_GENERIC=y
CONFIG_CMD_PART=y
CONFIG_HUSH_PARSER=y
CONFIG_ENV_IS_NOWHERE=y
# CONFIG_ENV_IS_IN_FAT is not set
# CONFIG_DISPLAY_CPUINFO is not set
# CONFIG_DISPLAY_BOARDINFO is not set
# CONFIG_DISPLAY_BOARDINFO_LATE is not set
CONFIG_SYS_CONSOLE_INFO_QUIET=y
#CONFIG_SPL_LOGLEVEL=8
#CONFIG_LOG_CONSOLE=y
#CONFIG_LOGLEVEL=8
#CONFIG_LOG_MAX_LEVEL=7
#CONFIG_LOG=y
CONFIG_BOOTDELAY=0
CONFIG_CMD_MYDBG=y
CONFIG_AXP_GPIO_LDO0_VOLT=3100
CONFIG_CMD_I2C=y
CONFIG_DM_I2C=y
CONFIG_I2C0_ENABLE=y
CONFIG_DM_TOUCHPANEL=y
CONFIG_EDT_FT5X06_TOUCHPANEL=y
CONFIG_CMD_TOUCH=y
CONFIG_CMD_TMENU=y
CONFIG_BACKLIGHT_PWM=y
CONFIG_PWM_SUNXI=y
CONFIG_DM_PWM=y
CONFIG_AXP_SW_ON=y
CONFIG_VIDEO_LCD_DCLK_PHASE=0
CONFIG_VIDEO_LCD_PANEL_LVDS=y
CONFIG_CMD_BMP=y
CONFIG_CMD_AXP=y
CONFIG_SYS_CLK_FREQ=1800000000
CONFIG_AXP_DCDC2_VOLT=1080
CONFIG_AXP_DCDC3_VOLT=1080
CONFIG_CMD_BOOTM=y
CONFIG_LZ4=y
CONFIG_FIT=y
# CONFIG_CMD_BOOTEFI is not set
# CONFIG_EFI_PARTITION is not set
# CONFIG_EFI_LOADER is not set
# CONFIG_CMD_NVEDIT_EFI is not set
# CONFIG_PRE_CONSOLE_BUFFER is not set
# CONFIG_SERIAL_PRESENT is not set
# CONFIG_SPL_SERIAL_PRESENT is not set
# CONFIG_SPL_BANNER_PRINT is not set
# CONFIG_SPL_DISPLAY_PRINT is not set
# CONFIG_VIDEO_DE2 #is not set
CONFIG_FIXUP_BDADDR="brcm,bcm20702a1"
```
