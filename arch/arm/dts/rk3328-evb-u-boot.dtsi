// SPDX-License-Identifier: GPL-2.0+
/*
 * (C) Copyright 2016-2019 Rockchip Electronics Co., Ltd
 */

#include "rk3328-u-boot.dtsi"
#include "rk3328-sdram-ddr3-666.dtsi"

&usbdrd3 {
	vbus-supply = <&vcc5v0_host_xhci>;
	status = "okay";
};

&usbdrd_dwc3 {
	status = "okay";
};
